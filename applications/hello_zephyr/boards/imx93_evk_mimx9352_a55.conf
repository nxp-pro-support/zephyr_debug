## west.yml
```yaml
manifest:
  defaults:
    revision: main

  remotes:
    - name: zephyrproject-rtos
      url-base: https://github.com/nxp-upstream
      
    - name: nxp-pro-support
      url-base: https://github.com/nxp-pro-support

  defaults:
    remote: zephyrproject-rtos
    revision: main

  projects:

    - name: zephyr
      remote: zephyrproject-rtos
      repo-path: zephyr
      revision: ad31337f1939c48a32eb40575240c06a17994b1d
      import:
        name-allowlist:
          - mbedtls
          - zcbor
          - hal_nxp
          - cmsis
    
    - name: zephyr-module-sample
      remote: nxp-pro-support
      repo-path: zephyr-module-sample
      revision: main
      path: ./modules/module-sample

  self:
    path: zephyr_debug
```
